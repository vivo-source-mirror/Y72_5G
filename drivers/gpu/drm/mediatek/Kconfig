## drivers/gpu/drm/mediatek/Kconfig
```kconfig
config DRM_MEDIATEK
	tristate "DRM Support for Mediatek SoCs"
	depends on DRM
	depends on COMMON_CLK
	depends on HAVE_ARM_SMCCC
	depends on OF
	select DRM_GEM_CMA_HELPER
	select DRM_KMS_HELPER
	select DRM_MIPI_DSI
	select DRM_PANEL
	select MEMORY
	select MTK_SMI
        select FONT_SUPPORT
	select GENERIC_PHY
	help
	  Choose this option if you have a Mediatek SoCs.
	  The module will be called mediatek-drm
	  This driver provides kernel mode setting and
	  buffer management to userspace.

config DRM_MEDIATEK_HDMI
	tristate "DRM HDMI Support for Mediatek SoCs"
	depends on DRM_MEDIATEK
	select SND_SOC_HDMI_CODEC if SND_SOC
	select GENERIC_PHY
	help
	  DRM/KMS HDMI driver for Mediatek SoCs

config MTK_PQ_COLOR_MODE
	string "Config PQ_COLOR_MODE (MDP & DISP COLOR on/off)"
	default "DISP"
	help
	  This control mdp color on/off and disp color on/off
	  if value equals to DISP, only display color is on.
	  if value equals to MDP, only mdp color is on.
	  if value equals to DISP_MDP, mdp and display color are both on.
	  if value equals to OFF, mdp and display color are both off.

config DRM_MTK_SHADOW_REGISTER_SUPPORT
	bool "DRM shadow register Support for Mediatek SoCs"
	depends on DRM_MEDIATEK
	help
	  DRM shadow register Support for Mediatek SoCs.
	  define CONFIG_DRM_MTK_SHADOW_REGISTER_SUPPORT to
	  enable Shadow Register on display.
	  This feature will de-risk configuration time shortage.
	  If you want to use Shadow Register on display,
	  please make sure it is Y in xxx_defconfig.
	  This feature depends on Mediatek SoCs HW spec.
	  If unsure, set N.

config DRM_MTK_DISABLE_AEE_LAYER
	bool "Disable AEE Layer for the customer who don't want to produce AEE"
	help
	  Disable AEE Layer if you do not want to produce AEE.
	  Default Mediatek SoCs will produce AEE when exception occurred.
	  if this value is y, will not produce AEE.
	  if this value is n, will produce AEE.
	  If you do not produce AEE, please set it to Y in xxx_defconfig.

config VIVO_BACKLIGHT_SUPPORT_LM3697
	bool "LM3697(KTD3137) Support"
	default n
	---help---
	  LED driver for lm3697(KTD3137) support.
	  Set y to support.
	  Set n to disable.
config VIVO_I2C_BACKLIGHT_CURRENT_21MA
	bool "LM3697(KTD3137) Support 21MA CURRENT"
	default n
	---help---
	  LED driver for lm3697(KTD3137) support.
	  Set y to support.
	  Set n to disable.
config VIVO_LCM_DCDC_SUPPORT
	bool "bias dcdc Support"
	default n
	---help---
	  bias driver for avdd avee support.
	  Set y to support.
	  Set n to disable.
config DRM_PANEL_TD2010_JDI657_NT36672E_FHDPLUS_VIDEO
	bool "NT36672E JDI657 FHD+ video mode panel"
	default n
	help
	  the first panel for td2010
config DRM_PANEL_PD2068_BOE652_NT36525B_HDPLUS_VDO
	bool "PD2068 BOE652 NT36525B HD+ video mode panel"
	default n
	help
	  the first panel for pd2068

config DRM_PANEL_PD2068_INX652_ILI9882N_HDPLUS_VDO
	bool "PD2068 INX652 ILI9882N HD+ video mode panel"
	default n
	help
	  the first panel for pd2068

config DRM_PANEL_PD2068_AUO652_FT8016_HDPLUS_VDO
	bool "PD2068 AUO652 FT8016 HD+ video mode panel"
	default n
	help
	  the first panel for pd2068

config DRM_PANEL_PD2069_TM658_NT36672C_FHDPLUS_VIDEO
	bool "PD2069 TM658 NT36672C FHD+ video mode panel"
	default n
	help
	  the first panel for pd2069

config DRM_PANEL_PD2069_HX658_ILI7807S_FHDPLUS_VIDEO
	bool "PD2069 HX658 ILI7807S FHD+ video mode panel"
	default n
	help
	  the first panel for pd2069

config DRM_PANEL_PD2069_DJN658_NT36672A_FHDPLUS_VIDEO
	bool "PD2069 DJN658 NT36672A FHD+ video mode panel"
	default n
	help
	  the first panel for pd2069

config DRM_PANEL_PD2069_TM658_NT36672C_90HZ_FHDPLUS_VIDEO
	bool "PD2069 TM658 NT36672C 90hz FHD+ video mode panel"
	default n
	help
	  the first panel for pd2069
```
